## buildroot/Config.in
```kconfig
source "$BR2_EXTERNAL_Y2LINUX_PATH/package/y2-connectivity/Config.in"
source "$BR2_EXTERNAL_Y2LINUX_PATH/package/y2-gpu-check/Config.in"
source "$BR2_EXTERNAL_Y2LINUX_PATH/package/reborn/Config.in"
source "$BR2_EXTERNAL_Y2LINUX_PATH/package/y2-update/Config.in"
source "$BR2_EXTERNAL_Y2LINUX_PATH/package/libfreeaptx/Config.in"
source "$BR2_EXTERNAL_Y2LINUX_PATH/package/libldac/Config.in"
source "$BR2_EXTERNAL_Y2LINUX_PATH/package/y2-codec-experiments/Config.in"
```

## buildroot/configs/y2_dev_defconfig
```kconfig
BR2_arm=y
BR2_cortex_a7=y
BR2_ARM_FPU_NEON_VFPV4=y
BR2_ARM_EABIHF=y
BR2_TOOLCHAIN_EXTERNAL=y
BR2_TOOLCHAIN_EXTERNAL_BOOTLIN=y
BR2_TOOLCHAIN_EXTERNAL_BOOTLIN_ARMV7_EABIHF_GLIBC_STABLE=y
BR2_REPRODUCIBLE=y
BR2_TARGET_GENERIC_HOSTNAME="y2linux"
BR2_TARGET_GENERIC_ISSUE="Y2Linux DEV-01 (Buildroot)"
BR2_TARGET_GENERIC_ROOT_PASSWD="!"
BR2_TARGET_GENERIC_GETTY=n
BR2_INIT_BUSYBOX=y
BR2_ROOTFS_DEVICE_CREATION_DYNAMIC_DEVTMPFS=y
BR2_ROOTFS_OVERLAY="$(BR2_EXTERNAL_Y2LINUX_PATH)/board/y2/overlay"
BR2_ROOTFS_POST_BUILD_SCRIPT="$(BR2_EXTERNAL_Y2LINUX_PATH)/board/y2/post-build.sh"
BR2_PACKAGE_BUSYBOX_SHOW_OTHERS=y
BR2_PACKAGE_BUSYBOX_CONFIG_FRAGMENT_FILES="$(BR2_EXTERNAL_Y2LINUX_PATH)/board/y2/busybox.fragment"
BR2_PACKAGE_IPROUTE2=y
BR2_PACKAGE_PROCPS_NG=y
BR2_PACKAGE_UTIL_LINUX=y
BR2_PACKAGE_UTIL_LINUX_BINARIES=y
BR2_PACKAGE_UTIL_LINUX_MOUNT=y
BR2_PACKAGE_UTIL_LINUX_FSCK=y
BR2_PACKAGE_UTIL_LINUX_SWITCH_ROOT=y
BR2_PACKAGE_UTIL_LINUX_SETTERM=y
BR2_PACKAGE_EVTEST=y
BR2_PACKAGE_LIBDRM=y
BR2_PACKAGE_LIBDRM_INSTALL_TESTS=y
BR2_PACKAGE_I2C_TOOLS=y
BR2_PACKAGE_ETHTOOL=y
BR2_PACKAGE_STRACE=y
BR2_PACKAGE_E2FSPROGS=y
BR2_PACKAGE_E2FSPROGS_E2FSCK=y
BR2_PACKAGE_DOSFSTOOLS=y
BR2_PACKAGE_DOSFSTOOLS_FSCK_FAT=y
BR2_PACKAGE_DROPBEAR=y
BR2_PACKAGE_DROPBEAR_DISABLE_REVERSEDNS=y
BR2_PACKAGE_KMOD=y
BR2_PACKAGE_KMOD_TOOLS=y
BR2_PACKAGE_MEMTESTER=y
BR2_TARGET_ROOTFS_TAR=y
BR2_TARGET_ROOTFS_EXT2=y
BR2_TARGET_ROOTFS_EXT2_4=y
BR2_TARGET_ROOTFS_EXT2_LABEL="Y2ROOT"
BR2_TARGET_ROOTFS_EXT2_SIZE="512M"
BR2_TARGET_ROOTFS_EXT2_MKFS_OPTIONS="-O ^64bit -U 79324c69-6e75-4801-8000-000000000001 -E lazy_itable_init=0,lazy_journal_init=0,hash_seed=79324c69-6e75-4801-8000-000000000001"
BR2_PACKAGE_HOST_KMOD=y

BR2_PACKAGE_ALSA_LIB=y
BR2_PACKAGE_ALSA_LIB_PCM=y
BR2_PACKAGE_ALSA_LIB_MIXER=y
BR2_PACKAGE_ALSA_UTILS=y
# BR2_PACKAGE_ALSA_UTILS_ALSACTL is not set
# BR2_PACKAGE_ALSA_UTILS_ALSAMIXER is not set
BR2_PACKAGE_ALSA_UTILS_APLAY=y
BR2_PACKAGE_ALSA_UTILS_AMIXER=y
BR2_PACKAGE_ALSA_UTILS_SPEAKER_TEST=y
```

## buildroot/configs/y2_production_defconfig
```kconfig
BR2_arm=y
BR2_cortex_a7=y
BR2_ARM_FPU_NEON_VFPV4=y
BR2_ARM_EABIHF=y
BR2_TOOLCHAIN_EXTERNAL=y
BR2_TOOLCHAIN_EXTERNAL_BOOTLIN=y
BR2_TOOLCHAIN_EXTERNAL_BOOTLIN_ARMV7_EABIHF_GLIBC_STABLE=y
BR2_REPRODUCIBLE=y
BR2_TARGET_GENERIC_HOSTNAME="y2linux"
BR2_TARGET_GENERIC_ISSUE="Y2Linux Production Storage v1 (Buildroot)"
BR2_TARGET_GENERIC_ROOT_PASSWD="!"
BR2_TARGET_GENERIC_GETTY=n
BR2_INIT_BUSYBOX=y
BR2_ROOTFS_DEVICE_CREATION_DYNAMIC_DEVTMPFS=y
BR2_ROOTFS_OVERLAY="$(BR2_EXTERNAL_Y2LINUX_PATH)/board/y2/overlay $(BR2_EXTERNAL_Y2LINUX_PATH)/board/y2/production-overlay"
BR2_ROOTFS_POST_BUILD_SCRIPT="$(BR2_EXTERNAL_Y2LINUX_PATH)/board/y2/post-build-production.sh"
BR2_PACKAGE_BUSYBOX_SHOW_OTHERS=y
BR2_PACKAGE_BUSYBOX_CONFIG_FRAGMENT_FILES="$(BR2_EXTERNAL_Y2LINUX_PATH)/board/y2/busybox.fragment"
BR2_PACKAGE_IPROUTE2=y
BR2_PACKAGE_PROCPS_NG=y
BR2_PACKAGE_UTIL_LINUX=y
BR2_PACKAGE_UTIL_LINUX_BINARIES=y
BR2_PACKAGE_UTIL_LINUX_MOUNT=y
BR2_PACKAGE_UTIL_LINUX_FSCK=y
BR2_PACKAGE_UTIL_LINUX_SWITCH_ROOT=y
BR2_PACKAGE_UTIL_LINUX_SETTERM=y
BR2_PACKAGE_EVTEST=y
BR2_PACKAGE_LIBDRM=y
BR2_PACKAGE_LIBDRM_INSTALL_TESTS=y
BR2_PACKAGE_I2C_TOOLS=y
BR2_PACKAGE_ETHTOOL=y
BR2_PACKAGE_STRACE=y
BR2_PACKAGE_E2FSPROGS=y
BR2_PACKAGE_E2FSPROGS_E2FSCK=y
BR2_PACKAGE_DOSFSTOOLS=y
BR2_PACKAGE_DOSFSTOOLS_FSCK_FAT=y
BR2_PACKAGE_DROPBEAR=y
BR2_PACKAGE_DROPBEAR_DISABLE_REVERSEDNS=y
BR2_PACKAGE_KMOD=y
BR2_PACKAGE_KMOD_TOOLS=y
BR2_PACKAGE_MEMTESTER=y
BR2_TARGET_ROOTFS_TAR=y
BR2_TARGET_ROOTFS_EXT2=y
BR2_TARGET_ROOTFS_EXT2_4=y
BR2_TARGET_ROOTFS_EXT2_LABEL="Y2ROOT"
BR2_TARGET_ROOTFS_EXT2_SIZE="512M"
BR2_TARGET_ROOTFS_EXT2_MKFS_OPTIONS="-O ^64bit -U 79324c69-6e75-4801-8000-000000000101 -E lazy_itable_init=0,lazy_journal_init=0,hash_seed=79324c69-6e75-4801-8000-000000000101"
BR2_PACKAGE_HOST_KMOD=y

BR2_PACKAGE_ALSA_LIB=y
BR2_PACKAGE_ALSA_LIB_PCM=y
BR2_PACKAGE_ALSA_LIB_MIXER=y
BR2_PACKAGE_ALSA_UTILS=y
# BR2_PACKAGE_ALSA_UTILS_ALSACTL is not set
# BR2_PACKAGE_ALSA_UTILS_ALSAMIXER is not set
BR2_PACKAGE_ALSA_UTILS_APLAY=y
BR2_PACKAGE_ALSA_UTILS_AMIXER=y
BR2_PACKAGE_ALSA_UTILS_SPEAKER_TEST=y

# Native connectivity; mutable credentials and bonds are on Y2DATA.
BR2_PACKAGE_WPA_SUPPLICANT=y
BR2_PACKAGE_WPA_SUPPLICANT_NL80211=y
BR2_PACKAGE_WPA_SUPPLICANT_AUTOSCAN=y
BR2_PACKAGE_WPA_SUPPLICANT_CLI=y
BR2_PACKAGE_WPA_SUPPLICANT_PASSPHRASE=y
BR2_PACKAGE_WPA_SUPPLICANT_CTRL_IFACE=y
BR2_PACKAGE_WPA_SUPPLICANT_DBUS=y
BR2_PACKAGE_WPA_SUPPLICANT_DBUS_INTROSPECTION=y
BR2_PACKAGE_IW=y
BR2_PACKAGE_WIRELESS_REGDB=y
BR2_PACKAGE_UTIL_LINUX_RFKILL=y
BR2_PACKAGE_DBUS=y
BR2_PACKAGE_BLUEZ5_UTILS=y
BR2_PACKAGE_BLUEZ5_UTILS_CLIENT=y
BR2_PACKAGE_BLUEZ5_UTILS_MONITOR=y
BR2_PACKAGE_BLUEZ5_UTILS_TOOLS=y
BR2_PACKAGE_BLUEZ5_UTILS_PLUGINS_AUDIO=y
# BR2_PACKAGE_BLUEZ5_UTILS_PLUGINS_NETWORK is not set
BR2_PACKAGE_BLUEZ_ALSA=y
BR2_PACKAGE_ALSA_PLUGINS=y
BR2_PACKAGE_LIBSAMPLERATE=y
BR2_PACKAGE_LIBCURL=y
BR2_PACKAGE_LIBCURL_CURL=y
BR2_PACKAGE_CA_CERTIFICATES=y
BR2_PACKAGE_OPENSSL=y
BR2_PACKAGE_IPERF3=y
BR2_PACKAGE_Y2_CONNECTIVITY=y
BR2_PACKAGE_UTIL_LINUX_FLOCK=y

# Standard hardware-rendered embedded graphics; no desktop/software rasterizer.
BR2_PACKAGE_MESA3D=y
BR2_PACKAGE_MESA3D_GALLIUM_DRIVER_LIMA=y
BR2_PACKAGE_MESA3D_GALLIUM_DRIVER_KMSRO=y
BR2_PACKAGE_MESA3D_OPENGL_EGL=y
BR2_PACKAGE_MESA3D_OPENGL_ES=y
BR2_PACKAGE_MESA3D_GBM=y
BR2_PACKAGE_Y2_GPU_CHECK=y

# Reborn Baseline 01; local audio and artwork only, no FFmpeg CLI/encoders/network.
BR2_PACKAGE_REBORN=y
BR2_PACKAGE_FFMPEG=y
# BR2_PACKAGE_FFMPEG_FFMPEG is not set
# BR2_PACKAGE_FFMPEG_FFPROBE is not set
BR2_PACKAGE_FFMPEG_SWSCALE=y
BR2_PACKAGE_FFMPEG_ENCODERS=""
BR2_PACKAGE_FFMPEG_DECODERS="flac mp3 mp3float aac vorbis opus pcm_s16le pcm_s16be pcm_s24le pcm_s24be pcm_s32le pcm_s32be pcm_f32le pcm_f64le mjpeg png"
BR2_PACKAGE_FFMPEG_MUXERS=""
BR2_PACKAGE_FFMPEG_DEMUXERS="flac mp3 mov ogg wav aac"
BR2_PACKAGE_FFMPEG_PARSERS="flac mpegaudio aac opus vorbis"
BR2_PACKAGE_FFMPEG_BSFS=""
BR2_PACKAGE_FFMPEG_PROTOCOLS="file"
BR2_PACKAGE_FFMPEG_FILTERS=""
# BR2_PACKAGE_FFMPEG_INDEVS is not set
# BR2_PACKAGE_FFMPEG_OUTDEVS is not set
BR2_PACKAGE_SQLITE=y
```

## buildroot/package/libfreeaptx/Config.in
```kconfig
config BR2_PACKAGE_LIBFREEAPTX
	bool "libfreeaptx"
	depends on !BR2_STATIC_LIBS
	help
	  LGPL-2.1-or-later aptX and aptX HD encoder/decoder library.
	  https://github.com/regularhunter/libfreeaptx
```

## buildroot/package/libldac/Config.in
```kconfig
config BR2_PACKAGE_LIBLDAC
	bool "libldac encoder and ABR"
	depends on !BR2_STATIC_LIBS
	help
	  Sony LDAC encoder and ABR, with EHfive's Linux CMake packaging.
	  AOSP NOTICE requires product certification; private qualification
	  is not public distribution approval.
	  https://github.com/EHfive/ldacBT
```

## buildroot/package/reborn/Config.in
```kconfig
config BR2_PACKAGE_REBORN
	bool "Reborn native music player"
	depends on BR2_TOOLCHAIN_HAS_THREADS
	depends on BR2_USE_MMU
	depends on !BR2_STATIC_LIBS
	select BR2_PACKAGE_FFMPEG
	select BR2_PACKAGE_FFMPEG_SWSCALE
	select BR2_PACKAGE_SQLITE
	select BR2_PACKAGE_ALSA_LIB
	select BR2_PACKAGE_DBUS
	select BR2_PACKAGE_UTIL_LINUX_LIBBLKID
	help
	  Native Rust Reborn Baseline 01. Requires pre-provisioned Rust 1.90.0
	  and the ARMv7 hard-float target; production Cargo builds are offline.
```

## buildroot/package/y2-codec-experiments/Config.in
```kconfig
config BR2_PACKAGE_Y2_CODEC_EXPERIMENTS
	bool "Y2 owner-private Bluetooth encoder qualification"
	depends on BR2_PACKAGE_BLUEZ_ALSA
	depends on BR2_PACKAGE_FDK_AAC_ARCH_SUPPORTS
	depends on BR2_INSTALL_LIBSTDCPP
	depends on !BR2_STATIC_LIBS
	select BR2_PACKAGE_FDK_AAC
	select BR2_PACKAGE_LIBFREEAPTX
	select BR2_PACKAGE_LIBLDAC
	help
	  Build AAC, aptX, aptX HD and LDAC for owner-private experiments.
	  Private integration images enable these endpoints experimentally.
	  SBC remains the bounded fallback. No public distribution approval
	  or physical qualification is implied; public packaging rejects this profile.
```

## buildroot/package/y2-connectivity/Config.in
```kconfig
config BR2_PACKAGE_Y2_CONNECTIVITY
	bool "Y2 native connectivity helpers"
	depends on BR2_USE_MMU && BR2_TOOLCHAIN_HAS_THREADS
	select BR2_PACKAGE_E2FSPROGS
	select BR2_PACKAGE_E2FSPROGS_E2FSCK
	select BR2_PACKAGE_LIBGLIB2
	select BR2_PACKAGE_ALSA_LIB
	depends on BR2_PACKAGE_BLUEZ5_UTILS
```

## buildroot/package/y2-font-noto-cjk/Config.in
```kconfig
config BR2_PACKAGE_Y2_FONT_NOTO_CJK
	bool "Noto Sans CJK JP Regular (Reborn CJK fallback)"
	help
	  The single OpenType/CFF file Noto Sans CJK JP Regular from the
	  notofonts/noto-cjk release Sans2.004. The Japanese-region font
	  carries all of CJK: kana, Hangul and Simplified/Traditional Han
	  (Japanese glyph forms). Reborn draws characters its built-in
	  Open Sans pages lack from it at runtime.
	  Installed as /usr/share/fonts/noto-cjk/NotoSansCJKjp-Regular.otf
	  (16.5 MB) with its SIL Open Font License 1.1.
	  https://github.com/notofonts/noto-cjk
```

## buildroot/package/y2-gpu-check/Config.in
```kconfig
config BR2_PACKAGE_Y2_GPU_CHECK
	bool "y2-gpu-check"
	depends on BR2_PACKAGE_MESA3D_GALLIUM_DRIVER_LIMA
	depends on BR2_PACKAGE_MESA3D_GALLIUM_DRIVER_KMSRO
	depends on BR2_PACKAGE_MESA3D_OPENGL_EGL
	depends on BR2_PACKAGE_MESA3D_OPENGL_ES
	help
	  Bounded native DRM/GBM/EGL/GLES2 platform qualification utility.
```

## buildroot/package/y2-mtp/Config.in
```kconfig
config BR2_PACKAGE_Y2_MTP
	bool "Y2 lightweight MTP responder"
	depends on BR2_TOOLCHAIN_HAS_THREADS
	select BR2_PACKAGE_SQLITE
	help
	  Pinned uMTP-Responder with Y2 media confinement and durable atomic uploads.
	  No raw block storage and no desktop framework dependencies.
```

## buildroot/package/y2-platform/Config.in
```kconfig
config BR2_PACKAGE_Y2_PLATFORM
	bool "y2-platform (Rust platform service command line)"
	depends on BR2_TOOLCHAIN_HAS_THREADS
	depends on BR2_USE_MMU
	depends on !BR2_STATIC_LIBS
	help
	  /usr/sbin/y2-platform from the platform/ Cargo workspace: the
	  platform contract's command line. Subcommands not ported to Rust
	  yet run the Python platform in /usr/lib/y2-platform. Requires
	  pre-provisioned Rust 1.99.0 and the ARMv7 hard-float target;
	  the Cargo build is offline (vendored crates).
```

## buildroot/package/y2-update/Config.in
```kconfig
config BR2_PACKAGE_Y2_UPDATE
	bool "Y2 signed rescue root updater"
	select BR2_PACKAGE_LIBSODIUM
	select BR2_PACKAGE_JSON_C
	select BR2_PACKAGE_ZLIB
	help
	  Detached Ed25519 verification and offline Y2ROOT backup/install/restore.
	  No BOOTIMG, partition table or protected partition writes.
```
